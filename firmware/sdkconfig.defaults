## v2-desk-pet/sdkconfig.defaults
```kconfig
CONFIG_IDF_TARGET="esp32s31"
CONFIG_IDF_EXPERIMENTAL_FEATURES=y
CONFIG_COMPILER_OPTIMIZATION_PERF=y
# bootloader 区固定 24 KiB（0x2000..0x8000），体积优化后才能容纳 ABI2 选择器。
CONFIG_BOOTLOADER_COMPILER_OPTIMIZATION_SIZE=y
CONFIG_ESPTOOLPY_FLASHMODE_QIO=y
CONFIG_ESPTOOLPY_FLASHSIZE_16MB=y
CONFIG_PARTITION_TABLE_CUSTOM=y
CONFIG_PARTITION_TABLE_CUSTOM_FILENAME="partitions.csv"
CONFIG_FREERTOS_HZ=1000

# ESP-Iris 独占 USB High-Speed；控制台留在 UART，关闭内置 USB Serial/JTAG。
CONFIG_ESP_CONSOLE_SECONDARY_NONE=y
CONFIG_ESP_IRIS_TRANSPORT_USB=y
CONFIG_ESP_IRIS_TRANSPORT_TCP=y
CONFIG_ESP_IRIS_NVS_PARTITION_NAME="sysmeta"
CONFIG_ESP_IRIS_TCP_PAIRING=y
CONFIG_ESP_IRIS_TCP_DEFER_UNTIL_NETIF=y
CONFIG_ESP_IRIS_USB_TASK_STACK_SIZE=2048
CONFIG_ESP_IRIS_SERVICE_STACK_SIZE=4096
CONFIG_ESP_IRIS_SERVICE_PERSISTENT=y
CONFIG_ESP_IRIS_SERVICE_CONTEXT_PSRAM=y
CONFIG_ESP_IRIS_SERVICE_STATE_PSRAM=y
CONFIG_ESP_IRIS_RPC_RESPONSE_PSRAM=y
CONFIG_ESP_IRIS_WIRE_BUFFERS_PSRAM=y
CONFIG_ESP_IRIS_LOG_RING_BYTES=4096
CONFIG_ESP_IRIS_MEDIA_BUFFER_PSRAM=y
CONFIG_TINYUSB_CDC_RX_BUFSIZE=1024
CONFIG_TINYUSB_CDC_TX_BUFSIZE=1024
CONFIG_TINYUSB_CDC_COUNT=2

# panic 后保留 coredump 与 ESP-Iris 崩溃前日志环。
CONFIG_ESP_COREDUMP_ENABLE_TO_FLASH=y
CONFIG_APP_RETRIEVE_LEN_ELF_SHA=64
CONFIG_BOOTLOADER_APP_ROLLBACK_ENABLE=y
CONFIG_APP_PROJECT_VER_FROM_CONFIG=y
CONFIG_APP_PROJECT_VER="1.0.0"

CONFIG_LV_CONF_SKIP=y
CONFIG_LV_COLOR_DEPTH_16=y
CONFIG_LV_OS_FREERTOS=y
CONFIG_LV_DEF_REFR_PERIOD=15
CONFIG_LV_DPI_DEF=130
CONFIG_LV_USE_CLIB_MALLOC=y
CONFIG_LV_USE_CLIB_STRING=y
CONFIG_LV_USE_CLIB_SPRINTF=y
CONFIG_LV_FONT_MONTSERRAT_14=y
CONFIG_LV_FONT_MONTSERRAT_20=y
CONFIG_LV_FONT_MONTSERRAT_28=y

# QSPI frame buffers are allocated from PSRAM by esp_lvgl_adapter.
CONFIG_SPIRAM=y
CONFIG_SPIRAM_SPEED_250M=y
CONFIG_SPIRAM_XIP_FROM_PSRAM=y
CONFIG_SPIRAM_MEMTEST=n
CONFIG_SPIRAM_ALLOW_BSS_SEG_EXTERNAL_MEMORY=y

CONFIG_ESP_MAIN_TASK_STACK_SIZE=20480
CONFIG_ESP_TASK_WDT_INIT=n
```
